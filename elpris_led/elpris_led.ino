// Elpris-LED v4
// Runs on ESP32 and ESP8266. Board differences are in platform.h.
// Requires: ArduinoJson 7.x, FastLED, WiFiManager (tzapu), ESP32 or ESP8266 Arduino core
//
// Features:
//  - Two color modes:
//    * Compared with a normal price (default, designed by @sealjo): today's prices against the average
//      of the last days, with a neutral yellow zone, plus two LEDs comparing tomorrow with today
//    * Cheapest to most expensive in the period shown (v3 and earlier)
//  - Time zone chosen from a list in the web UI (Sweden by default), stored in flash
//  - Configurable LED count (max MAX_LEDS), 15-minute prices are scaled to the strip
//  - Configurable direction, so time can run left to right however the strip is mounted
//  - The current 15 minutes pulses towards white and the time that has passed is dimmed to an
//    adjustable brightness, so "now" is easy to see
//  - Few API calls: today's prices once a day, a few past days for the normal price, tomorrow's
//    from 13:30 until they are available
//  - Prices are read one at a time from the response, so it fits in ESP8266 memory
//  - Exponential backoff + visual error indication, last error shown in the web UI
//  - Cached data is used as long as it covers the current time ("offline" only when it runs out)
//  - Settings are validated, WiFiManager fields show stored values
//  - No blocking calls in the web handler
//  - OTA and portal passwords are set in the web UI and stored in flash (no passwords in the code)
//  - Automatic updates: new GitHub releases are found every 6 hours and installed right after a
//    restart, when the most memory is free
//  - Network name elpris-led-xxxxxx in the router and http://elpris-led.local via mDNS
//  - Pure logic lives in elpris_logic.h and is tested with "make test" (see tests/)

#include "platform.h"     // must come first: board-specific includes and FastLED pin settings
#include <WiFiManager.h>
#include <ArduinoJson.h>
#include <FastLED.h>
#include <time.h>
#include "elpris_logic.h"

// version.h is generated by the release workflow from the version tag (e.g. v2.1)
#if __has_include("version.h")
#include "version.h"
#endif
#ifndef FW_VERSION
#define FW_VERSION "dev"   // local builds never auto-update
#endif

// ---------- HARDWARE ----------
// DATA_PIN is set per board in platform.h
#define MAX_LEDS     300       // upper limit, the actual count is set in the web UI
#define LED_TYPE     WS2812B
#define COLOR_ORDER  GRB

// ---------- CONSTANTS ----------
// SLOT_SEC, the backoff times, the TIME_ZONES list and the normal-price logic are in elpris_logic.h
const char* NTP_SERVER = "pool.ntp.org";
const char* DEFAULT_TZ = TIME_ZONES[0].tz;               // Sweden
const char* MDNS_NAME  = "elpris-led";                   // reachable as http://elpris-led.local

const int SLOTS_PER_DAY   = 96;
const int RING_SIZE       = PRICE_CACHE_SLOTS;   // per board, see platform.h

const int TOMORROW_FETCH_MIN = 13 * 60 + 30;  // start looking for tomorrow's prices at 13:30 local time
const int TOMORROW_ERROR_MIN = 16 * 60;       // missing tomorrow prices count as an error only after 16:00
const int STATUS_LEDS        = 3;             // number of LEDs that blink magenta on fetch errors

// Color modes
const int COLOR_MODE_RANGE  = 0;   // cheapest to most expensive in the period shown (v3 and earlier)
const int COLOR_MODE_NORMAL = 1;   // compared with a normal price (default from v4.0)
const int MAX_HISTORY_DAYS  = 7;   // past days that can count in the normal price

// How "now" is shown
const int     DEFAULT_PAST_PCT = 10;    // passed time at 10 % of normal brightness, unless set otherwise
const uint8_t PULSE_BPM        = 30;    // one pulse every 2 seconds
const uint8_t PULSE_WHITE_MAX  = 220;   // how far towards white the current LED goes (out of 255)

const unsigned long NOT_PUBLISHED_RETRY_MS  = 15UL * 60UL * 1000UL;

// Our own fetch error codes. HTTPClient uses -1 to -11, so these start at -100.
const int FETCH_ERR_BEGIN = -100;   // could not start the request
const int FETCH_ERR_PARSE = -101;   // the response could not be read as price data
const int FETCH_ERR_EMPTY = -102;   // the response had no prices

// ---------- UPDATES ----------
// The install page (GitHub Pages) publishes manifest.json with the latest version and one app binary per board.
// When a newer version is found, the lamp restarts and installs it first thing after connecting to wifi,
// before anything else has used memory. That matters on ESP8266, where https needs most of the free memory.
const char* UPDATE_BASE_URL = "https://flysen.github.io/elpris-led/";
const char* UPDATE_FIRMWARE = "firmware/" BOARD_NAME "/elpris-led.bin";
const unsigned long UPDATE_FIRST_CHECK_MS = 2UL * 60UL * 1000UL;          // first check 2 min after boot
const unsigned long UPDATE_INTERVAL_MS    = 6UL * 60UL * 60UL * 1000UL;   // then every 6 hours
const unsigned long UPDATE_RETRY_MS       = 60UL * 60UL * 1000UL;         // retry after 1 h if the check fails

// ---------- LED DATA ----------
CRGB leds[MAX_LEDS];
CRGB ledColor[MAX_LEDS];   // colors in time order; physicalLed() maps them onto the strip
int  winStartSlot = 0;     // first slot in the display window (local midnight today)
int  winSlots     = SLOTS_PER_DAY;   // one or two days, counted from real midnights (DST-safe)
int  timeLeds     = 100;   // LEDs that show the timeline; in normal-price mode the rest show tomorrow

// ---------- PRICE CACHE (ring buffer, key = absolute 15-minute slot since epoch) ----------
int32_t slotId[RING_SIZE];
float   slotPrice[RING_SIZE];

inline bool  hasSlot(int32_t s)   { return s >= 0 && slotId[s % RING_SIZE] == s; }
inline float getSlot(int32_t s)   { return slotPrice[s % RING_SIZE]; }
inline void  putSlot(int32_t s, float p) { slotId[s % RING_SIZE] = s; slotPrice[s % RING_SIZE] = p; }
void clearCache() { for (int i = 0; i < RING_SIZE; i++) slotId[i] = -1; }

// Sum of the cached prices in slots [from, to)
PriceSum sumSlots(int32_t from, int32_t to) {
  PriceSum s;
  for (int32_t x = from; x < to; x++) if (hasSlot(x)) s.add(getSlot(x));
  return s;
}

// ---------- PRICE HISTORY (one sum per past day, for the normal price) ----------
// Only a sum and a count per day are kept, not every quarter, so seven days fit in a few bytes.
struct HistoryDay { int32_t start = -1; PriceSum prices; };   // start = local midnight slot, -1 = empty
HistoryDay history[MAX_HISTORY_DAYS];

HistoryDay* findHistory(int32_t start) {
  for (HistoryDay& h : history) if (h.start == start) return &h;
  return nullptr;
}

void storeHistory(int32_t start, const PriceSum& prices) {
  HistoryDay* slot = findHistory(start);
  if (!slot) {   // replace an empty entry, or else the oldest
    slot = &history[0];
    for (HistoryDay& h : history) if (h.start < slot->start) slot = &h;
  }
  slot->start = start;
  slot->prices = prices;
}

void clearHistory() { for (HistoryDay& h : history) h = HistoryDay(); }

// ---------- SETTINGS ----------
Preferences preferences;
char cfgArea[5]  = "SE3";
char cfgTz[64];
int  cfgNightStart  = 23;
int  cfgNightEnd    = 6;
int  cfgBrightDay   = 40;
int  cfgBrightNight = 5;
int  cfgNumLeds     = 100;
bool cfgReverse     = false;  // true = time runs from the last LED to the first
bool cfgPulseWhite  = true;   // true = the current LED pulses towards white, false = in its own color
int  cfgPastPct     = DEFAULT_PAST_PCT;  // brightness of passed time in percent: 100 = not dimmed, 0 = off
int  cfgColorMode   = COLOR_MODE_NORMAL;
int  cfgHistDays    = 3;      // past days in the normal price, 0-7
int  cfgNeutralOre  = 20;     // within +- this many öre of the normal price it doesn't matter (yellow)
int  cfgStrongOre   = 80;     // from +- this many öre it is very cheap or very expensive
bool cfgFiveLevels  = true;   // 5 levels (green, yellow-green, yellow, orange, red) or 3 (green, yellow, red)
bool cfgNormTomorrow = true;  // count tomorrow in the normal price once its prices are known
bool cfgAutoUpdate  = true;
char cfgOtaPw[33]   = "";   // empty = OTA disabled
char cfgApPw[33]    = "";   // empty = open config portal, otherwise at least 8 characters

// WiFiManager fields (values are filled in from flash in setup). The time zone is set in the web UI.
WiFiManagerParameter pArea  ("area",   "Price area (SE1-SE4)",               "", 5);
WiFiManagerParameter pNstart("nstart", "Night start hour (0-23)",            "", 3);
WiFiManagerParameter pNend  ("nend",   "Night end hour (0-23)",              "", 3);
WiFiManagerParameter pBday  ("bday",   "Day brightness (1-255)",             "", 4);
WiFiManagerParameter pBnight("bnight", "Night brightness (0-255)",           "", 4);
WiFiManagerParameter pLeds  ("leds",   "Number of LEDs in the strip",        "", 4);
bool shouldSaveConfig = false;
void saveConfigCallback() { shouldSaveConfig = true; }

WebServer server(80);

// ---------- STATE ----------
bool         needRebuild   = true;
int          lastMday      = -1;
unsigned long nextAttemptMs = 0;
int          failStreak    = 0;
bool         fetchFailing  = false;
String       lastFetchError = "";            // shown in the web UI while fetching fails
unsigned long restartAtMs   = 0;
bool         otaActive     = false;
bool         mdnsActive    = false;
char         hostName[24]  = "elpris-led";   // network name, e.g. elpris-led-a1b2c3 (set in setup)

// Shown in the web UI in normal-price mode
float        normalPrice   = 0;              // SEK/kWh
bool         normalValid   = false;
int          normalDays    = 0;              // past days that were available for the normal price
float        tomorrowDiffOre[TOMORROW_PERIOD_COUNT];
bool         tomorrowDiffValid[TOMORROW_PERIOD_COUNT];

String        latestVersion      = "";     // latest release seen on the install page
String        updateMessage      = "";     // result of the last update attempt, shown in the web UI
unsigned long nextUpdateCheckMs  = UPDATE_FIRST_CHECK_MS;
bool          updateRequested    = false;  // "Check for updates now" was pressed
bool          restartingForUpdate = false; // a restart to install an update is coming

// =====================================================================
//  Settings: load / validate / save
// =====================================================================
void sanitizeSettings() {
  for (int i = 0; cfgArea[i]; i++) cfgArea[i] = toupper(cfgArea[i]);
  if (!validArea(cfgArea)) strcpy(cfgArea, "SE3");

  cfgNightStart  = constrain(cfgNightStart, 0, 23);
  cfgNightEnd    = constrain(cfgNightEnd, 0, 23);
  cfgBrightDay   = constrain(cfgBrightDay, 1, 255);
  cfgBrightNight = constrain(cfgBrightNight, 0, 255);
  cfgNumLeds     = constrain(cfgNumLeds, 1, MAX_LEDS);
  cfgPastPct     = constrain(cfgPastPct, 0, 100);
  cfgColorMode   = constrain(cfgColorMode, COLOR_MODE_RANGE, COLOR_MODE_NORMAL);
  cfgHistDays    = constrain(cfgHistDays, 0, MAX_HISTORY_DAYS);
  cfgNeutralOre  = constrain(cfgNeutralOre, 1, 300);
  cfgStrongOre   = constrain(cfgStrongOre, cfgNeutralOre, 500);   // "very" is never closer than the neutral zone

  if (strlen(cfgTz) < 3) strlcpy(cfgTz, DEFAULT_TZ, sizeof(cfgTz));
  if (strlen(cfgApPw) > 0 && strlen(cfgApPw) < 8) cfgApPw[0] = '\0';   // WPA2 requires at least 8 characters
}

void loadSettings() {
  String a = preferences.getString("area", "SE3");
  a.toCharArray(cfgArea, sizeof(cfgArea));
  String z = preferences.getString("tz", DEFAULT_TZ);
  z.toCharArray(cfgTz, sizeof(cfgTz));
  cfgNightStart  = preferences.getInt("nstart", 23);
  cfgNightEnd    = preferences.getInt("nend", 6);
  cfgBrightDay   = preferences.getInt("bday", 40);
  cfgBrightNight = preferences.getInt("bnight", 5);
  cfgNumLeds     = preferences.getInt("leds", 100);
  cfgReverse     = preferences.getBool("reverse", false);
  cfgPulseWhite  = preferences.getBool("pulsewh", true);
  // v3.0 had an on/off setting for dimming instead of a percentage; see initialPastPercent()
  int savedPastPct = preferences.getInt("pastpct", -1);
  cfgPastPct     = initialPastPercent(savedPastPct >= 0, savedPastPct,
                                      preferences.getBool("dimpast", true), DEFAULT_PAST_PCT);
  // Lamps updating from v3 get the new default color mode; it can be switched back in the web UI
  cfgColorMode   = preferences.getInt("colormode", COLOR_MODE_NORMAL);
  cfgHistDays    = preferences.getInt("histdays", 3);
  cfgNeutralOre  = preferences.getInt("neutral", 20);
  cfgStrongOre   = preferences.getInt("strong", 80);
  cfgFiveLevels  = preferences.getBool("levels5", true);
  cfgNormTomorrow = preferences.getBool("normtmrw", true);
  cfgAutoUpdate  = preferences.getBool("autoupd", true);
  preferences.getString("otapw", "").toCharArray(cfgOtaPw, sizeof(cfgOtaPw));
  preferences.getString("appw", "").toCharArray(cfgApPw, sizeof(cfgApPw));
  sanitizeSettings();
}

void saveSettings() {
  preferences.putString("area", cfgArea);
  preferences.putString("tz", cfgTz);
  preferences.putInt("nstart", cfgNightStart);
  preferences.putInt("nend", cfgNightEnd);
  preferences.putInt("bday", cfgBrightDay);
  preferences.putInt("bnight", cfgBrightNight);
  preferences.putInt("leds", cfgNumLeds);
  preferences.putBool("reverse", cfgReverse);
  preferences.putBool("pulsewh", cfgPulseWhite);
  preferences.putInt("pastpct", cfgPastPct);
  preferences.putInt("colormode", cfgColorMode);
  preferences.putInt("histdays", cfgHistDays);
  preferences.putInt("neutral", cfgNeutralOre);
  preferences.putInt("strong", cfgStrongOre);
  preferences.putBool("levels5", cfgFiveLevels);
  preferences.putBool("normtmrw", cfgNormTomorrow);
  preferences.putBool("autoupd", cfgAutoUpdate);
  preferences.putString("otapw", cfgOtaPw);
  preferences.putString("appw", cfgApPw);
}

void applyTimezone() {
  setenv("TZ", cfgTz, 1);
  tzset();
}

// =====================================================================
//  Time helpers (daysFromCivil, parseIso and localMidnightSlot are in elpris_logic.h)
// =====================================================================
bool dayCovered(int32_t startSlot) {
  return hasSlot(startSlot + 2) && hasSlot(startSlot + 50) && hasSlot(startSlot + 90);
}

String priceUrl(time_t now, int dayOffset) {
  struct tm t;
  localtime_r(&now, &t);
  t.tm_mday += dayOffset;
  t.tm_isdst = -1;
  mktime(&t);
  char buf[16];
  strftime(buf, sizeof(buf), "%Y/%m-%d", &t);
  return String("https://www.elprisetjustnu.se/api/v1/prices/") + buf + "_" + cfgArea + ".json";
}

String memoryInfo() {
  return "free memory " + String(ESP.getFreeHeap()) + " bytes, largest block " + String(maxFreeBlock()) + " bytes";
}

// =====================================================================
//  Fetching prices
// =====================================================================
String describeFetchError(int code) {
  if (code > 0)               return "server answered HTTP " + String(code);
  if (code == FETCH_ERR_BEGIN) return "could not start the request";
  if (code == FETCH_ERR_PARSE) return "could not read the price data";
  if (code == FETCH_ERR_EMPTY) return "no prices in the response";
  return HTTPClient::errorToString(code);   // connection, TLS and timeout errors
}

// Fetches one day of prices. With sumOnly, the prices are added to that sum (for past days in the
// normal price) instead of being stored per quarter in the cache.
bool fetchDay(const String& url, int& code, PriceSum* sumOnly) {
  WiFiClientSecure client;
  client.setInsecure();
  HTTPClient http;
  setHttpTimeouts(http);
  http.useHTTP10(true);
  if (!http.begin(client, url)) { code = FETCH_ERR_BEGIN; return false; }

  code = http.GET();
  if (code != HTTP_CODE_OK) { http.end(); return false; }

  // The response is a JSON array with one object per price. Reading the objects one at a time,
  // instead of the whole array at once, keeps memory use small enough for ESP8266.
  JsonDocument filter;
  filter["SEK_per_kWh"] = true;
  filter["time_start"]  = true;
  filter["time_end"]    = true;

  Stream& stream = http.getStream();
  int stored = 0;
  bool parseError = !stream.find("[");
  if (!parseError) {
    do {
      JsonDocument item;
      DeserializationError err = deserializeJson(item, stream, DeserializationOption::Filter(filter));
      if (err) { parseError = true; break; }

      const char* ts = item["time_start"];
      const char* te = item["time_end"];
      if (!ts) continue;
      time_t a, b;
      if (!parseIso(ts, a)) continue;
      if (!te || !parseIso(te, b)) b = a;   // priceSlots then assumes one hour
      float p = item["SEK_per_kWh"] | 0.0f;
      int32_t s0, s1;
      priceSlots(a, b, s0, s1);
      for (int32_t s = s0; s < s1; s++) {
        if (sumOnly) sumOnly->add(p); else putSlot(s, p);
        stored++;
      }
    } while (stream.findUntil(",", "]"));
  }
  http.end();

  if (stored == 0) { code = parseError ? FETCH_ERR_PARSE : FETCH_ERR_EMPTY; return false; }
  return true;
}

// The most recent past day missing from the history that the normal price needs, as a day offset
// (-1 = yesterday), or 0 when nothing is missing or the normal-price mode isn't used
int missingHistoryDay(time_t now) {
  if (cfgColorMode != COLOR_MODE_NORMAL) return 0;
  for (int k = 1; k <= cfgHistDays; k++) {
    if (!findHistory(localMidnightSlot(now, -k))) return -k;
  }
  return 0;
}

void serviceFetch(const struct tm& t, time_t now) {
  if ((long)(millis() - nextAttemptMs) < 0) return;

  int32_t todaySlot    = localMidnightSlot(now, 0);
  int32_t tomorrowSlot = localMidnightSlot(now, 1);
  int minutes = t.tm_hour * 60 + t.tm_min;

  // Today first, then the past days for the normal price, then tomorrow once it may be published
  int dayOffset;
  if (!dayCovered(todaySlot)) dayOffset = 0;
  else if ((dayOffset = missingHistoryDay(now)) != 0) {}
  else if (minutes >= TOMORROW_FETCH_MIN && !dayCovered(tomorrowSlot)) dayOffset = 1;
  else return;

  String memBefore = memoryInfo();
  int code = 0;
  unsigned long ms;

  if (dayOffset < 0) {
    // A past day: only its sum is kept. If it can't be fetched it is stored as empty and left out of the
    // normal price, so a missing old day never blocks tomorrow's prices.
    PriceSum day;
    bool ok = fetchDay(priceUrl(now, dayOffset), code, &day);
    storeHistory(localMidnightSlot(now, dayOffset), ok ? day : PriceSum());
    needRebuild = true;
    nextAttemptMs = millis() + 1000UL;
    if (ok) Serial.printf("Prices fetched for the normal price (day %d)\n", dayOffset);
    else    Serial.printf("Could not fetch day %d for the normal price: %s\n", dayOffset, describeFetchError(code).c_str());
    return;
  }

  bool ok = fetchDay(priceUrl(now, dayOffset), code, nullptr);
  ms = millis();

  if (ok) {
    failStreak = 0;
    fetchFailing = false;
    lastFetchError = "";
    needRebuild = true;
    int32_t startSlot = dayOffset ? tomorrowSlot : todaySlot;
    nextAttemptMs = ms + (dayCovered(startSlot) ? 1000UL : NOT_PUBLISHED_RETRY_MS);
    Serial.printf("Prices fetched (day +%d)\n", dayOffset);
  } else if (dayOffset == 1 && code == 404) {
    nextAttemptMs = ms + NOT_PUBLISHED_RETRY_MS;
    fetchFailing = (minutes >= TOMORROW_ERROR_MIN);
    if (fetchFailing) lastFetchError = "tomorrow's prices are not published yet";
    Serial.println("Tomorrow's prices not published yet");
  } else {
    failStreak++;
    unsigned long d = backoffMs(failStreak);
    nextAttemptMs = ms + d;
    fetchFailing = (dayOffset == 0) || (minutes >= TOMORROW_ERROR_MIN);
    lastFetchError = describeFetchError(code) + " (code " + String(code) + ", " + memBefore + ")";
    Serial.printf("Fetch failed: %s, retrying in %lu s\n", lastFetchError.c_str(), d / 1000);
  }
}

// =====================================================================
//  Automatic updates from GitHub releases
// =====================================================================
bool fetchLatestVersion(String& out) {
  WiFiClientSecure client;
  client.setInsecure();
  HTTPClient http;
  setHttpTimeouts(http);
  http.useHTTP10(true);
  if (!http.begin(client, String(UPDATE_BASE_URL) + "manifest.json")) return false;

  int code = http.GET();
  if (code != HTTP_CODE_OK) { http.end(); return false; }

  JsonDocument filter;
  filter["version"] = true;
  JsonDocument doc;
  DeserializationError err = deserializeJson(doc, http.getStream(), DeserializationOption::Filter(filter));
  http.end();
  if (err) return false;

  const char* v = doc["version"];
  if (!v) return false;
  out = v;
  return true;
}

void showUpdatingOnStrip() {
  fill_solid(leds, cfgNumLeds, CRGB::Black);
  for (int i = 0; i < cfgNumLeds; i += 4) leds[i] = CRGB(0, 40, 40);   // dim cyan dots while updating
  FastLED.show();
}

// Downloads and installs the firmware. Reboots on success; returns only if it failed.
void installUpdate() {
  String memBefore = memoryInfo();
  Serial.printf("Installing update %s (running %s on %s, %s)\n",
                latestVersion.c_str(), FW_VERSION, BOARD_NAME, memBefore.c_str());
  showUpdatingOnStrip();

  WiFiClientSecure client;
  client.setInsecure();
  httpUpdate.rebootOnUpdate(true);
  t_httpUpdate_return r = httpUpdate.update(client, String(UPDATE_BASE_URL) + UPDATE_FIRMWARE);

  if (r == HTTP_UPDATE_FAILED) {
    updateMessage = "Update to " + latestVersion + " failed: " + httpUpdate.getLastErrorString() + " (" + memBefore + ")";
  } else {
    updateMessage = "No update installed";
  }
  Serial.println(updateMessage);
  needRebuild = true;
}

// Restart and install the update first thing after the restart, when the most memory is free
void restartToInstall(const String& version) {
  preferences.putString("pendver", version);
  preferences.putBool("pendupd", true);
  updateMessage = "Restarting to install " + version + "...";
  restartingForUpdate = true;
  showUpdatingOnStrip();
  restartAtMs = millis() + 1500;   // time for the web page to answer first
  Serial.println(updateMessage);
}

// Called in setup right after wifi connects, before the web server, mDNS and price fetching start
void installPendingUpdate() {
  if (!preferences.getBool("pendupd", false)) return;
  preferences.putBool("pendupd", false);   // clear first, so a failing update can't cause a restart loop
  latestVersion = preferences.getString("pendver", "");
  installUpdate();
  // Still here: the update failed. Start normally and try again at the next regular check.
  nextUpdateCheckMs = millis() + UPDATE_INTERVAL_MS;
}

void serviceUpdate() {
  if (restartingForUpdate) return;
  if (!updateRequested && (long)(millis() - nextUpdateCheckMs) < 0) return;
  if (WiFi.status() != WL_CONNECTED) return;

  bool manual = updateRequested;
  updateRequested = false;

  String v;
  if (!fetchLatestVersion(v)) {
    nextUpdateCheckMs = millis() + UPDATE_RETRY_MS;
    if (manual) updateMessage = "Could not check for updates (" + memoryInfo() + ")";
    Serial.println("Update check failed");
    return;
  }
  nextUpdateCheckMs = millis() + UPDATE_INTERVAL_MS;
  latestVersion = v;

  if (isNewerVersion(v.c_str(), FW_VERSION)) {
    if (cfgAutoUpdate || manual) restartToInstall(v);
    else updateMessage = v + " is available";
  } else if (manual) {
    updateMessage = "Already up to date";
  }
}

// =====================================================================
//  Build the colors for the strip
// =====================================================================
inline void ledRange(int i, int& s0, int& s1) {
  ledSlotRange(i, winSlots, timeLeds, s0, s1);
}

// Normal-price mode: today against the normal price on the first LEDs, then one off LED and one LED per
// period comparing tomorrow with the same hours today. See elpris_logic.h for the levels and colors.
void rebuildNormal(time_t now, bool tomorrow) {
  int32_t tomorrowStart = winStartSlot + winSlots;

  PriceSum pool = sumSlots(winStartSlot, tomorrowStart);
  normalDays = 0;
  for (int k = 1; k <= cfgHistDays; k++) {
    HistoryDay* h = findHistory(localMidnightSlot(now, -k));
    if (h && !h->prices.empty()) { pool.add(h->prices); normalDays++; }
  }
  if (tomorrow && cfgNormTomorrow) pool.add(sumSlots(tomorrowStart, localMidnightSlot(now, 2)));
  normalValid = !pool.empty();
  normalPrice = pool.mean();
  float normalOre = normalPrice * 100;

  CRGB prev = CRGB::Black;
  for (int i = 0; i < timeLeds; i++) {
    int s0, s1;
    ledRange(i, s0, s1);
    PriceSum led = sumSlots(winStartSlot + s0, winStartSlot + s1);
    if (led.empty()) {
      ledColor[i] = prev;
    } else {
      int level = levelForPrice(led.mean() * 100, normalOre, cfgNeutralOre, cfgStrongOre);
      ledColor[i] = CHSV(levelHue(level, cfgFiveLevels), 255, 255);
    }
    prev = ledColor[i];
  }

  for (int p = 0; p < TOMORROW_PERIOD_COUNT; p++) tomorrowDiffValid[p] = false;
  if (timeLeds >= cfgNumLeds) return;   // strip too short for tomorrow's LEDs

  ledColor[timeLeds] = CRGB::Black;     // separates today from tomorrow
  for (int p = 0; p < TOMORROW_PERIOD_COUNT; p++) {
    int idx = timeLeds + 1 + p;
    ledColor[idx] = CRGB::Black;        // off until tomorrow's prices are known
    if (!tomorrow) continue;
    const HourPeriod& hp = TOMORROW_PERIODS[p];
    PriceSum today = sumSlots(localHourSlot(now, 0, hp.startHour), localHourSlot(now, 0, hp.endHour));
    PriceSum tmrw  = sumSlots(localHourSlot(now, 1, hp.startHour), localHourSlot(now, 1, hp.endHour));
    if (today.empty() || tmrw.empty()) continue;
    float diffOre = (tmrw.mean() - today.mean()) * 100;
    tomorrowDiffOre[p] = diffOre;
    tomorrowDiffValid[p] = true;
    ledColor[idx] = CHSV(levelHue(levelForDiff(diffOre, cfgNeutralOre, cfgStrongOre), cfgFiveLevels), 255, 255);
  }
}

void rebuildTimeline(time_t now) {
  // The window is counted from real midnights so 23- and 25-hour days (DST) come out right
  winStartSlot = localMidnightSlot(now, 0);
  int32_t tomorrowStart = localMidnightSlot(now, 1);
  int32_t dayAfterStart = localMidnightSlot(now, 2);
  bool tomorrow = dayCovered(tomorrowStart);
  bool normalMode = cfgColorMode == COLOR_MODE_NORMAL;
  timeLeds = dayLedCount(cfgNumLeds, normalMode);

  if (normalMode) {
    winSlots = tomorrowStart - winStartSlot;   // today only; tomorrow is summarized on the last LEDs
    rebuildNormal(now, tomorrow);
    return;
  }

  normalValid = false;
  winSlots = (tomorrow ? dayAfterStart : tomorrowStart) - winStartSlot;

  float mn = 1e9f, mx = -1e9f;
  for (int s = 0; s < winSlots; s++) {
    if (!hasSlot(winStartSlot + s)) continue;
    float p = getSlot(winStartSlot + s);
    if (p < mn) mn = p;
    if (p > mx) mx = p;
  }

  CRGB prev = CRGB::Black;
  for (int i = 0; i < timeLeds; i++) {
    int s0, s1;
    ledRange(i, s0, s1);
    float sum = 0; int cnt = 0;
    for (int s = s0; s < s1; s++) {
      if (hasSlot(winStartSlot + s)) { sum += getSlot(winStartSlot + s); cnt++; }
    }
    if (cnt == 0) {
      ledColor[i] = prev;
    } else {
      float p = sum / cnt;
      float ratio = (mx > mn) ? (p - mn) / (mx - mn) : 0.5f;
      uint8_t hue = (uint8_t)((1.0f - ratio) * 96);
      ledColor[i] = CHSV(hue, 255, 255);
    }
    prev = ledColor[i];
  }
}

// Color for one LED, given where it is in time: dimmed if it has passed, pulsing if it is now
CRGB displayColor(const CRGB& priceColor, LedTime when) {
  CRGB c = priceColor;
  if (when == LED_NOW) {
    if (cfgPulseWhite) c = blend(c, CRGB::White, beatsin8(PULSE_BPM, 0, PULSE_WHITE_MAX));   // price color <-> white
    else               c.nscale8(beatsin8(PULSE_BPM, 30, 255));                              // brighter <-> darker
  } else if (when == LED_PAST && cfgPastPct < 100) {
    c.nscale8(percentToScale(cfgPastPct));
  }
  return c;
}

// =====================================================================
//  Web interface
// =====================================================================
String htmlEscape(const String& s) {
  String o;
  for (unsigned i = 0; i < s.length(); i++) {
    char c = s[i];
    switch (c) {
      case '&':  o += "&amp;";  break;
      case '<':  o += "&lt;";   break;
      case '>':  o += "&gt;";   break;
      case '"':  o += "&quot;"; break;
      case '\'': o += "&#39;";  break;
      default:   o += c;
    }
  }
  return o;
}

String checkbox(const char* name, bool checked, const char* label, const char* help) {
  return String("<p><label><input type='checkbox' name='") + name + "' value='1'" + (checked ? " checked" : "") + ">" +
         label + "</label><br><small>" + help + "</small></p>";
}

String option(const String& value, const String& label, bool selected) {
  return "<option value='" + value + "'" + (selected ? " selected" : "") + ">" + label + "</option>";
}

// Drop-down with the time zones in TIME_ZONES, with the current one selected. A time zone that isn't in
// the list (set by an older version) is kept as its own entry, so saving the page doesn't change it.
String timeZoneSelect() {
  String s = "<label>Time zone:</label><select name='tz'>";
  bool found = false;
  for (int i = 0; i < TIME_ZONE_COUNT; i++) {
    const TimeZoneChoice& z = TIME_ZONES[i];
    bool sel = strcmp(cfgTz, z.tz) == 0;
    found = found || sel;
    s += option(z.tz, z.label, sel);
  }
  if (!found) {
    String tz = htmlEscape(String(cfgTz));
    s += option(tz, "Custom (" + tz + ")", true);
  }
  s += "</select>";
  return s;
}

String signedOre(float ore) {
  return String(ore >= 0 ? "+" : "") + String((int)lroundf(ore)) + " öre";
}

// Normal price and tomorrow's comparison, shown under Live Status in normal-price mode
String normalModeStatus() {
  if (cfgColorMode != COLOR_MODE_NORMAL) return "";
  String s = "<p><strong>Normal price:</strong> ";
  if (normalValid) {
    s += String((int)lroundf(normalPrice * 100)) + " öre<br><small>Average of ";
    s += normalDays ? String(normalDays) + (normalDays == 1 ? " past day, " : " past days, ") : String("");
    s += "today";
    s += (cfgNormTomorrow && tomorrowDiffValid[0]) ? " and tomorrow" : "";
    s += ". Yellow within ±" + String(cfgNeutralOre) + " öre.</small>";
  } else {
    s += "not known yet";
  }
  s += "</p>";
  if (timeLeds < cfgNumLeds) {
    s += "<p><strong>Tomorrow vs today:</strong> ";
    for (int p = 0; p < TOMORROW_PERIOD_COUNT; p++) {
      if (p) s += ", ";
      s += String(TOMORROW_PERIODS[p].label) + " ";
      s += tomorrowDiffValid[p] ? signedOre(tomorrowDiffOre[p]) : String("not published yet");
    }
    s += "</p>";
  }
  return s;
}

void handleRoot() {
  time_t now = time(nullptr);
  int32_t ns = (int32_t)(now / SLOT_SEC);
  String priceTxt = (now > 1700000000 && hasSlot(ns)) ? String((int)lroundf(getSlot(ns) * 100)) + " öre/kWh" : String("unavailable");
  String status = fetchFailing ? "Cannot fetch prices (retrying automatically)" : "OK";
  if (fetchFailing && lastFetchError.length()) status += "<br><small>Last error: " + htmlEscape(lastFetchError) + "</small>";
  String otaTxt = otaActive ? "Active" : "Off (set an OTA password below)";
  String fwTxt = String(FW_VERSION) + " (" + BOARD_NAME + ")";
  if (latestVersion.length()) fwTxt += ", latest release: " + htmlEscape(latestVersion);
  String ip = WiFi.localIP().toString();
  String addrTxt = mdnsActive ? String("http://") + MDNS_NAME + ".local or http://" + ip : String("http://") + ip;

  // Reload the page by itself while an update check or an update restart is going on
  String refresh = "";
  if (updateRequested)          refresh = "<meta http-equiv='refresh' content='5'>";
  else if (restartingForUpdate) refresh = "<meta http-equiv='refresh' content='30;url=/'>";

  String html;
  html.reserve(11000);
  html += "<html lang='en'><head><meta charset='utf-8'><meta name='viewport' content='width=device-width, initial-scale=1'>" + refresh;
  html += "<style>body{font-family:sans-serif;background:#121212;color:#e0e0e0;padding:20px;max-width:400px;margin:auto;}";
  html += "input,select{width:100%;padding:10px;margin:8px 0;background:#222;color:#fff;border:1px solid #444;border-radius:4px;box-sizing:border-box;}";
  html += "input[type=checkbox]{width:auto;margin-right:8px;}";
  html += "button{width:100%;padding:12px;background:#4CAF50;color:white;border:none;border-radius:4px;font-size:16px;font-weight:bold;cursor:pointer;}";
  html += ".card{background:#1e1e1e;padding:15px;border-radius:8px;margin-bottom:15px;border:1px solid #333;}small{color:#999;}h4{margin:18px 0 4px;}</style></head><body>";

  html += "<h2>Elpris LED</h2><div class='card'><h3>Live Status</h3>";
  html += "<p><strong>Current price:</strong> " + priceTxt + "<br><small>Spot price excl. VAT, grid fees and tax</small></p>";
  html += normalModeStatus();
  html += "<p><strong>Area:</strong> " + String(cfgArea) + "</p>";
  html += "<p><strong>Status:</strong> " + status + "</p>";
  html += "<p><strong>OTA:</strong> " + otaTxt + "</p>";
  html += "<p><strong>Firmware:</strong> " + fwTxt + "</p>";
  html += "<p><strong>Address:</strong> " + addrTxt + "<br><small>Name in the router: " + String(hostName) + "</small></p>";
  html += "<p><small>Free memory: " + String(ESP.getFreeHeap()) + " bytes, largest block " + String(maxFreeBlock()) + " bytes</small></p></div>";

  html += "<div class='card'><h3>Updates</h3>";
  if (updateMessage.length()) html += "<p>" + htmlEscape(updateMessage) + "</p>";
  if (!restartingForUpdate) html += "<form action='/update' method='POST'><button type='submit'>Check for updates now</button></form>";
  html += "<p><small>Installs a newer release if there is one: the lamp restarts, installs it and restarts again, which takes about a minute.</small></p></div>";

  html += "<div class='card'><h3>Settings</h3><form action='/save' method='POST'>";
  html += "<label>Price area:</label><select name='area'>";
  const char* areas[] = {"SE1", "SE2", "SE3", "SE4"};
  for (int i = 0; i < 4; i++) html += option(areas[i], areas[i], String(cfgArea) == areas[i]);
  html += "</select>";

  html += "<label>Number of LEDs (changing it restarts the device):</label><input type='number' name='leds' min='1' max='" + String(MAX_LEDS) + "' value='" + String(cfgNumLeds) + "'>";

  html += "<h4>Colors</h4><select name='colormode'>";
  html += option(String(COLOR_MODE_NORMAL), "Compared with a normal price", cfgColorMode == COLOR_MODE_NORMAL);
  html += option(String(COLOR_MODE_RANGE), "Cheapest to most expensive", cfgColorMode == COLOR_MODE_RANGE);
  html += "</select><p><small><b>Compared with a normal price:</b> today from midnight to midnight, green when cheaper than "
          "usual, yellow when it doesn't matter, red when more expensive. The last three LEDs are one off LED and two that "
          "compare tomorrow 08-17 and 17-24 with the same hours today (off until tomorrow's prices are published). "
          "<b>Cheapest to most expensive:</b> today, and tomorrow once published, from green to red within that period.</small></p>";

  html += "<label>Normal price: past days (0-7):</label><input type='number' name='histdays' min='0' max='7' value='" + String(cfgHistDays) + "'>";
  html += "<label>Doesn't matter within (± öre):</label><input type='number' name='neutral' min='1' max='300' value='" + String(cfgNeutralOre) + "'>";
  html += "<label>Very cheap or expensive from (± öre):</label><input type='number' name='strong' min='1' max='500' value='" + String(cfgStrongOre) + "'>";
  html += "<label>Levels:</label><select name='levels'>";
  html += option("5", "5: green, yellow-green, yellow, orange, red", cfgFiveLevels);
  html += option("3", "3: green, yellow, red", !cfgFiveLevels);
  html += "</select>";
  html += checkbox("normtmrw", cfgNormTomorrow, "Count tomorrow in the normal price",
                   "Today's colors may then change when tomorrow's prices arrive after lunch: an expensive tomorrow makes today greener.");
  html += "<p><small>These four settings apply to <i>Compared with a normal price</i>. Prices are spot prices excl. VAT, in öre.</small></p>";

  html += "<h4>Strip</h4>";
  html += checkbox("reverse", cfgReverse, "Reverse direction",
                   "Normally midnight is at the end where the strip's cable is connected. Tick this if time runs the wrong way, e.g. right to left.");
  html += checkbox("pulsewh", cfgPulseWhite, "Pulse the current 15 minutes towards white",
                   "Makes \"now\" stand out against any price color. Untick to pulse in the price color instead.");

  html += "<label>Brightness of passed time (0-100 %):</label><input type='number' name='pastpct' min='0' max='100' value='" + String(cfgPastPct) + "'>";
  html += "<p><small>Time that has passed is shown at this share of the normal brightness, so the hours that are left stand out. "
          "100 = not dimmed, 0 = off. The eye sees brightness logarithmically, so 10 % looks clearly dimmed but not dark.</small></p>";

  html += timeZoneSelect();
  html += "<p><small>Where the lamp is, so the strip starts at local midnight. Daylight saving time is handled automatically.</small></p>";

  html += "<label>Night mode start (hour 0-23):</label><input type='number' name='nstart' min='0' max='23' value='" + String(cfgNightStart) + "'>";
  html += "<label>Night mode end (hour 0-23):</label><input type='number' name='nend' min='0' max='23' value='" + String(cfgNightEnd) + "'>";
  html += "<label>Day brightness (1-255):</label><input type='number' name='bday' min='1' max='255' value='" + String(cfgBrightDay) + "'>";
  html += "<label>Night brightness (0-255):</label><input type='number' name='bnight' min='0' max='255' value='" + String(cfgBrightNight) + "'>";

  html += "<h4>Device</h4>";
  html += "<p><label><input type='checkbox' name='autoupd' value='1'" + String(cfgAutoUpdate ? " checked" : "") + ">Install new releases automatically</label></p>";

  html += "<label>OTA password (empty = unchanged, changing it restarts the device):</label>";
  html += "<input type='password' name='otapw' maxlength='32' autocomplete='new-password' placeholder='" + String(strlen(cfgOtaPw) ? "(set)" : "(not set)") + "'>";
  html += "<label>Config portal password, at least 8 characters (empty = unchanged):</label>";
  html += "<input type='password' name='appw' minlength='8' maxlength='32' autocomplete='new-password' placeholder='" + String(strlen(cfgApPw) ? "(set)" : "(open portal)") + "'>";

  html += "<button type='submit'>Save changes</button></form></div>";
  html += "<p><small>Try the settings without a lamp in the <a style='color:#9ad' href='https://flysen.github.io/elpris-led/emulator/'>emulator</a>.</small></p></body></html>";

  server.send(200, "text/html", html);
}

void handleSave() {
  char oldArea[5], oldTz[64];
  strlcpy(oldArea, cfgArea, sizeof(oldArea));
  strlcpy(oldTz, cfgTz, sizeof(oldTz));
  int oldLeds = cfgNumLeds;
  bool otaPwChanged = false;

  if (server.hasArg("area"))      server.arg("area").toCharArray(cfgArea, sizeof(cfgArea));
  if (server.hasArg("tz"))        server.arg("tz").toCharArray(cfgTz, sizeof(cfgTz));
  if (server.hasArg("nstart"))    cfgNightStart  = server.arg("nstart").toInt();
  if (server.hasArg("nend"))      cfgNightEnd    = server.arg("nend").toInt();
  if (server.hasArg("bday"))      cfgBrightDay   = server.arg("bday").toInt();
  if (server.hasArg("bnight"))    cfgBrightNight = server.arg("bnight").toInt();
  if (server.hasArg("leds"))      cfgNumLeds     = server.arg("leds").toInt();
  if (server.hasArg("pastpct"))   cfgPastPct     = server.arg("pastpct").toInt();
  if (server.hasArg("colormode")) cfgColorMode   = server.arg("colormode").toInt();
  if (server.hasArg("histdays"))  cfgHistDays    = server.arg("histdays").toInt();
  if (server.hasArg("neutral"))   cfgNeutralOre  = server.arg("neutral").toInt();
  if (server.hasArg("strong"))    cfgStrongOre   = server.arg("strong").toInt();
  if (server.hasArg("levels"))    cfgFiveLevels  = server.arg("levels").toInt() != 3;
  cfgReverse      = server.hasArg("reverse");   // unchecked boxes are not sent
  cfgPulseWhite   = server.hasArg("pulsewh");
  cfgNormTomorrow = server.hasArg("normtmrw");
  cfgAutoUpdate   = server.hasArg("autoupd");

  if (server.hasArg("otapw") && server.arg("otapw").length() > 0) {
    String pw = server.arg("otapw");
    if (pw != cfgOtaPw) { pw.toCharArray(cfgOtaPw, sizeof(cfgOtaPw)); otaPwChanged = true; }
  }
  if (server.hasArg("appw") && server.arg("appw").length() >= 8) {
    server.arg("appw").toCharArray(cfgApPw, sizeof(cfgApPw));   // takes effect the next time the portal opens
  }

  sanitizeSettings();
  saveSettings();

  if (strcmp(oldTz, cfgTz) != 0) applyTimezone();
  if (strcmp(oldArea, cfgArea) != 0) {
    clearCache();
    clearHistory();
    nextAttemptMs = 0;
    failStreak = 0;
    fetchFailing = false;
    lastFetchError = "";
  }
  nextAttemptMs = 0;      // fetch any past days a changed normal-price setting needs
  needRebuild = true;     // colors depend on most settings, so always recalculate
  if (oldLeds != cfgNumLeds || otaPwChanged) restartAtMs = millis() + 1500;

  server.sendHeader("Location", "/", true);
  server.send(303, "text/plain", "");
}

void handleUpdate() {
  updateRequested = true;   // the check runs in loop() so the web request returns right away
  updateMessage = "Checking for updates...";
  server.sendHeader("Location", "/", true);
  server.send(303, "text/plain", "");
}

// =====================================================================
//  Setup / loop
// =====================================================================
// WiFiManager lives only inside this function, so its memory is freed once wifi is connected
void connectWifi() {
  pArea.setValue(cfgArea, 5);
  pNstart.setValue(String(cfgNightStart).c_str(), 3);
  pNend.setValue(String(cfgNightEnd).c_str(), 3);
  pBday.setValue(String(cfgBrightDay).c_str(), 4);
  pBnight.setValue(String(cfgBrightNight).c_str(), 4);
  pLeds.setValue(String(cfgNumLeds).c_str(), 4);

  WiFiManager wm;
  wm.addParameter(&pArea);
  wm.addParameter(&pNstart);
  wm.addParameter(&pNend);
  wm.addParameter(&pBday);
  wm.addParameter(&pBnight);
  wm.addParameter(&pLeds);
  wm.setSaveConfigCallback(saveConfigCallback);
  wm.setHostname(hostName);         // set before connecting, so the router learns the name
  wm.setConnectTimeout(30);         // try the saved network for 30 s
  wm.setConfigPortalTimeout(180);   // close the portal after 3 min and restart, so wifi is tried again

  const char* apPw = strlen(cfgApPw) ? cfgApPw : nullptr;   // no password set = open portal
  if (!wm.autoConnect("Elpris-LED-Config", apPw)) {
    Serial.println("Could not connect, restarting...");
    delay(3000);
    ESP.restart();
  }

  if (shouldSaveConfig) {
    int oldLeds = cfgNumLeds;
    strlcpy(cfgArea, pArea.getValue(), sizeof(cfgArea));
    cfgNightStart  = String(pNstart.getValue()).toInt();
    cfgNightEnd    = String(pNend.getValue()).toInt();
    cfgBrightDay   = String(pBday.getValue()).toInt();
    cfgBrightNight = String(pBnight.getValue()).toInt();
    cfgNumLeds     = String(pLeds.getValue()).toInt();
    sanitizeSettings();
    saveSettings();
    if (oldLeds != cfgNumLeds) { delay(500); ESP.restart(); }
  }
}

void setup() {
  Serial.begin(115200);
  clearCache();
  clearHistory();
  Serial.printf("Elpris-LED %s (%s)\n", FW_VERSION, BOARD_NAME);

  if (!preferences.begin("elpris-config", false)) Serial.println("Could not open settings storage");
  loadSettings();
  timeLeds = dayLedCount(cfgNumLeds, cfgColorMode == COLOR_MODE_NORMAL);

  FastLED.addLeds<LED_TYPE, DATA_PIN, COLOR_ORDER>(leds, cfgNumLeds);
  FastLED.setBrightness(cfgBrightDay);
  fill_solid(leds, cfgNumLeds, CRGB::Blue);
  FastLED.show();

  // Name shown in the router, unique per lamp, e.g. elpris-led-a1b2c3
  snprintf(hostName, sizeof(hostName), "elpris-led-%s", chipSuffix().c_str());

  connectWifi();
  Serial.printf("Connected as %s, IP address: %s\n", hostName, WiFi.localIP().toString().c_str());

  // An update found before the restart is installed now, while nothing else uses memory
  installPendingUpdate();

  // http://elpris-led.local. With several lamps, only one answers to this name; use the IP for the others.
  if (MDNS.begin(MDNS_NAME)) {
    MDNS.addService("http", "tcp", 80);
    mdnsActive = true;
    Serial.printf("Reachable at http://%s.local\n", MDNS_NAME);
  } else {
    Serial.println("mDNS could not start");
  }

  // OTA only starts when a password has been set in the web UI
  if (strlen(cfgOtaPw)) {
    ArduinoOTA.setHostname(hostName);
    ArduinoOTA.setPassword(cfgOtaPw);
    startOta();
    if (mdnsActive) MDNS.enableArduino(OTA_PORT, true);   // lets the Arduino IDE find the lamp as a network port
    otaActive = true;
  } else {
    Serial.println("OTA off: set an OTA password in the web UI");
  }

  server.on("/", HTTP_GET, handleRoot);
  server.on("/save", HTTP_POST, handleSave);
  server.on("/update", HTTP_POST, handleUpdate);
  server.begin();

  startNtp(cfgTz, NTP_SERVER);
}

void loop() {
  if (otaActive) ArduinoOTA.handle();
  if (mdnsActive) serviceMdns();
  server.handleClient();
  if (restartAtMs && (long)(millis() - restartAtMs) >= 0) ESP.restart();
  if (restartingForUpdate) { delay(20); return; }   // keep the cyan dots until the restart
  serviceUpdate();

  time_t now = time(nullptr);

  if (now < 1700000000) {
    uint8_t b = beatsin8(20, 20, 160);
    fill_solid(leds, cfgNumLeds, CRGB(0, 0, b));
    FastLED.show();
    delay(20);
    return;
  }

  struct tm t;
  localtime_r(&now, &t);

  if (t.tm_mday != lastMday) { lastMday = t.tm_mday; needRebuild = true; }

  serviceFetch(t, now);
  if (needRebuild) { rebuildTimeline(now); needRebuild = false; }

  bool isNight = isNightHour(t.tm_hour, cfgNightStart, cfgNightEnd);
  FastLED.setBrightness(isNight ? cfgBrightNight : cfgBrightDay);

  int32_t nowSlot = (int32_t)(now / SLOT_SEC);

  if (!hasSlot(nowSlot)) {
    uint8_t b = beatsin8(20, 20, 160);
    if (failStreak > 0) fill_solid(leds, cfgNumLeds, CRGB(b, 0, b));
    else                fill_solid(leds, cfgNumLeds, CRGB(0, 0, b));
    FastLED.show();
    delay(20);
    return;
  }

  // ledColor is in time order (midnight first); physicalLed() puts it on the strip in the chosen direction.
  // LEDs after the timeline (tomorrow in normal-price mode) are never dimmed and never pulse.
  int cur = nowSlot - winStartSlot;
  for (int i = 0; i < cfgNumLeds; i++) {
    CRGB c = ledColor[i];
    if (i < timeLeds) {
      int s0, s1;
      ledRange(i, s0, s1);
      c = displayColor(c, ledTimeState(s0, s1, cur));
    }
    leds[physicalLed(i, cfgNumLeds, cfgReverse)] = c;
  }

  // Error indicator on the first LEDs in time order, so it follows the chosen direction too
  if (fetchFailing) {
    CRGB c = ((millis() / 500) % 2) ? CRGB::Magenta : CRGB::Black;
    for (int i = 0; i < STATUS_LEDS && i < cfgNumLeds; i++) leds[physicalLed(i, cfgNumLeds, cfgReverse)] = c;
  }

  FastLED.show();
  delay(20);
}
